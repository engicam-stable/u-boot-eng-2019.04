## board/engicam/icore_mx8mm/Kconfig
```kconfig
if TARGET_ICORE_MX8MM

config SYS_BOARD
	default "icore_mx8mm"

config SYS_VENDOR
	default "engicam"

config SYS_CONFIG_NAME
	default "icore_mx8mm"

source "board/freescale/common/Kconfig"

endif
```

## board/engicam/icorem6/Kconfig
```kconfig
if TARGET_ICOREM6_COMMON

config SYS_BOARD
	default "icorem6"

config SYS_VENDOR
	default "engicam"

config SYS_CONFIG_NAME
	default "icorem6"

config SYS_TEXT_BASE
    default 0x17800000

endif
```

## board/engicam/smarcore_mx8xq/Kconfig
```kconfig
if TARGET_SMARCORE_MX8XQ

config SYS_BOARD
	default "smarcore_mx8xq"

config SYS_VENDOR
	default "engicam"

config SYS_CONFIG_NAME
	default "smarcore_mx8xq"

source "board/freescale/common/Kconfig"

endif
```

## configs/icoremx6dl_sd_defconfig
```kconfig
CONFIG_ARM=y
CONFIG_ARCH_MX6=y
CONFIG_TARGET_ICOREM6DL=y
CONFIG_NR_DRAM_BANKS=1
CONFIG_VIDEO=y
CONFIG_SYS_EXTRA_OPTIONS="IMX_CONFIG=board/engicam/icorem6/icorem6dl.cfg"
CONFIG_ENV_IS_IN_MMC=y
CONFIG_BOOTDELAY=1
# CONFIG_CONSOLE_MUX is not set
CONFIG_SYS_CONSOLE_IS_IN_ENV=y
CONFIG_SYS_CONSOLE_OVERWRITE_ROUTINE=y
CONFIG_SUPPORT_RAW_INITRD=y
CONFIG_BOUNCE_BUFFER=y
CONFIG_HUSH_PARSER=y
CONFIG_CMD_BOOTZ=y
# CONFIG_CMD_IMLS is not set
# CONFIG_CMD_FLASH is not set
CONFIG_CMD_MEMTEST=y
CONFIG_CMD_MMC=y
CONFIG_CMD_PART=y
CONFIG_CMD_I2C=y
CONFIG_CMD_USB=y
CONFIG_CMD_USB_MASS_STORAGE=y
CONFIG_CMD_GPIO=y
CONFIG_CMD_DHCP=y
CONFIG_RMII=y
CONFIG_CMD_PING=y
CONFIG_CMD_CACHE=y
CONFIG_CMD_EXT2=y
CONFIG_CMD_EXT4=y
CONFIG_CMD_EXT4_WRITE=y
CONFIG_CMD_FAT=y
CONFIG_FAT_WRITE=y
CONFIG_CMD_FS_GENERIC=y
CONFIG_USB=y
CONFIG_DM_USB=y
CONFIG_USB_STORAGE=y
CONFIG_USB_GADGET=y
CONFIG_USB_GADGET_DOWNLOAD=y
CONFIG_USB_GADGET_MANUFACTURER="FSL"
CONFIG_USB_GADGET_VENDOR_NUM=0x0525
CONFIG_USB_GADGET_PRODUCT_NUM=0xa4a5
CONFIG_CI_UDC=y
# CONFIG_VIDEO_SW_CURSOR is not set
# CONFIG_OF_LIBFDT=y

CONFIG_DEFAULT_DEVICE_TREE="icore-mx6dl"
CONFIG_OF_CONTROL=y
CONFIG_DM_GPIO=y
CONFIG_DM_I2C=y
CONFIG_DM_MMC=y
CONFIG_FSL_ESDHC=y
CONFIG_PINCTRL=y
CONFIG_PINCTRL_IMX6=y
CONFIG_PHYLIB=y
CONFIG_MII=y
CONFIG_REGMAP=y
CONFIG_SYSCON=y
CONFIG_EFI_PARTITION=y
```
